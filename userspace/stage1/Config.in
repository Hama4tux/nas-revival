## userspace/stage1/configs/nsa310_stage1_defconfig
```kconfig
BR2_arm=y
BR2_arm926t=y
BR2_ARM_EABI=y
BR2_ARM_SOFT_FLOAT=y
BR2_ARM_INSTRUCTIONS_ARM=y
BR2_TOOLCHAIN_BUILDROOT_UCLIBC=y
BR2_PTHREADS_NONE=y
BR2_GCC_VERSION_13_X=y
BR2_KERNEL_HEADERS_CUSTOM_TARBALL=y
BR2_KERNEL_HEADERS_CUSTOM_TARBALL_LOCATION="https://cdn.kernel.org/pub/linux/kernel/v2.6/linux-2.6.31.8.tar.xz"
BR2_PACKAGE_HOST_LINUX_HEADERS_CUSTOM_REALLY_OLD=y
BR2_PACKAGE_HOST_LINUX_HEADERS_LICENSE_FILES="COPYING"
BR2_UCLIBC_CONFIG_FRAGMENT_FILES="$(BR2_EXTERNAL_NAS_REVIVAL_STAGE1_PATH)/uclibc.fragment"
# BR2_UCLIBC_INSTALL_UTILS is not set
BR2_SHARED_LIBS=y
BR2_OPTIMIZE_S=y
BR2_REPRODUCIBLE=y
BR2_DOWNLOAD_FORCE_CHECK_HASHES=y
BR2_GLOBAL_PATCH_DIR="$(BR2_EXTERNAL_NAS_REVIVAL_STAGE1_PATH)/patches"
BR2_INIT_NONE=y
BR2_ROOTFS_DEVICE_CREATION_STATIC=y
BR2_ROOTFS_STATIC_DEVICE_TABLE=""
# BR2_ROOTFS_MERGED_USR is not set
# BR2_TARGET_ENABLE_ROOT_LOGIN is not set
BR2_TARGET_GENERIC_HOSTNAME=""
BR2_TARGET_GENERIC_ISSUE="NAS Revival Stage 1: shared legacy kernel; experimental chroot"
BR2_SYSTEM_BIN_SH_BUSYBOX=y
BR2_PACKAGE_BUSYBOX=y
BR2_PACKAGE_BUSYBOX_CONFIG_FRAGMENT_FILES="$(BR2_EXTERNAL_NAS_REVIVAL_STAGE1_PATH)/busybox.fragment"
BR2_PACKAGE_DROPBEAR=y
BR2_PACKAGE_DROPBEAR_SMALL=y
# BR2_PACKAGE_DROPBEAR_CLIENT is not set
BR2_PACKAGE_DROPBEAR_DISABLE_REVERSEDNS=y
# BR2_PACKAGE_DROPBEAR_LEGACY_CRYPTO is not set
BR2_PACKAGE_DROPBEAR_LOCALOPTIONS_FILE="$(BR2_EXTERNAL_NAS_REVIVAL_STAGE1_PATH)/dropbear-localoptions.h"
BR2_ROOTFS_POST_BUILD_SCRIPT="$(BR2_EXTERNAL_NAS_REVIVAL_STAGE1_PATH)/post-build.sh"
# BR2_TARGET_ROOTFS_TAR is not set
# BR2_LINUX_KERNEL is not set
```
